/* source keypos definitions */
#include "../zmk-nodefree-config/keypos_def/keypos_42keys.h"

/* map Zen's extra keys */
#define X_LT &kp TAB
#define X_LM &kp LALT
#define X_LB &kp LGUI
#define X_RT &kp ESC
#define X_RM &kp SLASH
#define X_RB &kp LSHFT
#define X_LH &smart_mouse  // thumb row, left
#define X_RH SMART_NUM  // thumb row, right

/* activate bluetooth */
#define CONFIG_WIRELESS 1

/* source the main keymap */
#include "base.keymap"

/* use 6-column layout*/
/ { chosen { zmk,matrix_transform = &default_transform; }; };

