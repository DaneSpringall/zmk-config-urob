/zmk-nodefree-config/keypos_def/keypos_42keys_wide.h

#define X_LT &kp TAB
#define X_LM &kp LALT
#define X_LB &kp LGUI
#define X_LH &kp SPACE

#define X_RT &kp ESC
#define X_RM &kp SQT
#define X_RB &kp LGUI

#define CONFIG_WIRELESS 1

#include "base.keymap"

/ { chosen { zmk,matrix_transform = &six_column_transform; }; };
